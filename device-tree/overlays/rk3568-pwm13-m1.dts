// SPDX-License-Identifier: GPL-2.0
// Source: radxa/overlays, commit bba8c5214481f607066fe2c227d1e9942daf19e2
// Radxa Zero 3 pin 24: PWM13-M1 (exclusive GPIO4_C6).
/dts-v1/;
/plugin/;

/ {
	metadata {
		title = "Enable PWM13-M1";
		compatible = "radxa,rock-3a", "radxa,rock-3b", "radxa,rock-3c", "radxa,zero3", "radxa,e25";
		category = "misc";
		exclusive = "GPIO4_C6";
		description = "Enable PWM13-M1 on Radxa ZERO 3 pin 24.";
	};
};

&pwm13 {
	status = "okay";
	pinctrl-names = "active";
	pinctrl-0 = <&pwm13m1_pins>;
};
